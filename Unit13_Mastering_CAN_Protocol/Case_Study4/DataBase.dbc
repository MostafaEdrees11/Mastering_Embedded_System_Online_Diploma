VERSION ""

NS_ :

BS_:

BU_: ECU2_Speed_Sensor ECU1_ACC_CMD

BO_ 939 Speed_Value_Message: 1 ECU2_Speed_Sensor
 SG_ Speed_Value : 0|8@1+ (1,0) [0|255] ""  ECU1_ACC_CMD

BO_ 48 ACC_CMD_Message: 1 ECU1_ACC_CMD
 SG_ ACC_State : 0|8@1+ (1,0) [0|1] ""  ECU2_Speed_Sensor
